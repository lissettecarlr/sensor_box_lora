## rt_thread_lorawan/bsp/stm32l151-lorawan-sensor-PM25/Kconfig
```kconfig
mainmenu "RT-Thread Configuration"

config $BSP_DIR
    string
    option env="BSP_ROOT"
    default "."

config $RTT_DIR
    string
    option env="RTT_ROOT"
    default "../../.."

config $PKGS_DIR
    string
    option env="PKGS_ROOT"
    default "packages"

config %RTT_MY_PCKS_DIR
    string
    option env="MY_PKGS"
    default "my_packages"

source "$RTT_DIR/Kconfig"
source "$PKGS_DIR/Kconfig"
source "../libraries/Kconfig"
source "board/Kconfig"
source "$RTT_MY_PCKS_DIR/Kconfig"
```
